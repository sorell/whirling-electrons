// SSD1331 | ARDUINO NANO
//     GDN | GDN
//     VCC | 3V3
//     SCL | D13 (sclk)
//     SDA | D11 (mosi)
//     RES | D8
//      DC | D9
//      CS | D10

#include <Adafruit_GFX.h>
#include <Adafruit_SSD1331.h>
#include <avr/pgmspace.h>
#include <SPI.h>
#include "softTimer.h"
#include "btnDebounce.h"
#include "notes.h"


#define SCLK_PIN 13
#define MOSI_PIN 11
#define CS_PIN   10
#define RST_PIN  9
#define DC_PIN   8

#define BTNUP_PIN 2
#define BTNDN_PIN 3
#define BUZZER_PIN 6


// ****************************************************************************
// *** Songs                                                                ***
// ****************************************************************************

struct Note {
	int f;  // Frequence
	int t;  // Time
};

struct SongPart {
	Note const *notes;
	uint8_t size;
};

struct Song {
	char const *name;
	uint16_t nameColor;
	SongPart const *parts;
	uint8_t size;
};


// Star Wars Imperial March theme from somewhere.. sorry, lost the reference.
Note constexpr PROGMEM vader1[] = {
	{A4, 500}, {A4, 500}, {A4, 500}, {F4, 350}, {C5, 150}, {A4, 500}, {F4, 350}, {C5, 150}, {A4, 650}, {0, 500}, 
	{E5, 500}, {E5, 500}, {E5, 500}, {F5, 350}, {C5, 150}, {A4, 500}, {F4, 350}, {C5, 150}, {A4, 650}, {0, 500}
};
Note constexpr PROGMEM vader2[] = {
	{A5, 500}, {A4, 300}, {A4, 150}, {A5, 500}, {Gs5, 325}, {G5, 175}, {Fs5, 125}, {F5, 125}, {Fs5, 250}, {0, 325},
	{As4, 250}, {Ds5, 500}, {D5, 325}, {Cs5, 175}, {C5, 125}, {B4, 125}, {C5, 250}, {0, 350}
};
Note constexpr PROGMEM vader3[] = {
	{F4, 250}, {Gs4, 500}, {F4, 350}, {A4, 125}, {C5, 500}, {A4, 375}, {C5, 125}, {E5, 650}, {0, 500}
};
Note constexpr PROGMEM vader4[] = {
	{F4, 250}, {Gs4, 500}, {F4, 350}, {C5, 125}, {A4, 500}, {F4, 375}, {C5, 125}, {A4, 650}
};
SongPart constexpr vaderSong[] = {
	{vader1, sizeof(vader1)/sizeof(vader1[0])}, 
	{vader2, sizeof(vader2)/sizeof(vader2[0])}, 
	{vader3, sizeof(vader3)/sizeof(vader3[0])}, 
	{vader2, sizeof(vader2)/sizeof(vader2[0])}, 
	{vader4, sizeof(vader4)/sizeof(vader4[0])}
};


// Game of Thrones theme from https://flat.io/score/597a6d912c9b0e5c57a1b244-game-of-thrones-main-theme
int constexpr gotTempo = TEMPO(80);

Note constexpr PROGMEM got2[] = {
	// Part 2, repeated 4x
	{G4, NL_8(gotTempo)}, {C4, NL_8(gotTempo)}, {E4, NL_16(gotTempo)}, {F4, NL_16(gotTempo)}
};
Note constexpr PROGMEM got3_7[] = {
    // Parts 3 and 7
	{G3, NL_4dot(gotTempo)}, {C3, NL_4dot(gotTempo)}, {E3, NL_16(gotTempo)}, {F3, NL_16(gotTempo)}, {G3, NL_4dot(gotTempo)}, {C3, NL_4(gotTempo)}, {E3, NL_16(gotTempo)}, {F3, NL_16(gotTempo)}
};
Note constexpr PROGMEM got4[] = {
	// Part 4
	{D4, NL_8(gotTempo)}, {G3, NL_8(gotTempo)}, {B3, NL_16(gotTempo)}, {C4, NL_16(gotTempo)},
	{D4, NL_8(gotTempo)}, {G3, NL_8(gotTempo)}, {B3, NL_16(gotTempo)}, {C4, NL_16(gotTempo)},
	{D4, NL_8(gotTempo)}, {G3, NL_8(gotTempo)},	{B3, NL_16(gotTempo)}, {C4, NL_16(gotTempo)}, 
	{C4, NL_8(gotTempo)}, {G3, NL_8(gotTempo)}, {B3, NL_8(gotTempo)}
};
Note constexpr PROGMEM got5_9[] = {
	// Parts 5 and 9
	{F3, NL_4dot(gotTempo)}, {B2, NL_4dot(gotTempo)}, {E3, NL_16(gotTempo)}, {D3, NL_16(gotTempo)}, {F3, NL_4dot(gotTempo)}, {B2, NL_4dot(gotTempo)}
};
Note constexpr PROGMEM got6[] = {
	// Part 6
	{E3, NL_16(gotTempo)}, {D3, NL_16(gotTempo)}, {C3, NL_8(gotTempo)}, {A3, NL_16(gotTempo)}, {B3, NL_16(gotTempo)}, 
	{C4, NL_8(gotTempo)}, {F3, NL_8(gotTempo)}, {A3, NL_16(gotTempo)}, {B3, NL_16(gotTempo)}, {C4, NL_8(gotTempo)}, {F3, NL_8(gotTempo)}, {A3, NL_16(gotTempo)}, {B3, NL_16(gotTempo)},
	{C4, NL_8(gotTempo)}, {G3, NL_8(gotTempo)}, {A3, NL_8(gotTempo)}
};
Note constexpr PROGMEM got8[] = {
	// Part 8
	{D4, NL_8(gotTempo)}, {G3, NL_8(gotTempo)}, {B3, NL_16(gotTempo)}, {C4, NL_16(gotTempo)}, 
	{D4, NL_8(gotTempo)}, {G3, NL_8(gotTempo)}, {B3, NL_16(gotTempo)}, {C4, NL_16(gotTempo)}, 
	{D4, NL_8(gotTempo)}, {G3, NL_8(gotTempo)}, {B3, NL_16(gotTempo)}, {C4, NL_16(gotTempo)}, 
	{D4, NL_8(gotTempo)}, {G3, NL_8(gotTempo)}, {B3, NL_8(gotTempo)}
};

SongPart constexpr gotSong[] = {
	{got2, sizeof(got2)/sizeof(got2[0])}, {got2, sizeof(got2)/sizeof(got2[0])},	{got2, sizeof(got2)/sizeof(got2[0])},
	{got2, sizeof(got2)/sizeof(got2[0])}, {got3_7, sizeof(got3_7)/sizeof(got3_7[0])},
	{got4, sizeof(got4)/sizeof(got4[0])}, {got5_9, sizeof(got5_9)/sizeof(got5_9[0])},
	{got6, sizeof(got6)/sizeof(got6[0])}, {got3_7, sizeof(got3_7)/sizeof(got3_7[0])},
	{got8, sizeof(got8)/sizeof(got8[0])}, {got5_9, sizeof(got5_9)/sizeof(got5_9[0])}
};


// Amelie's Waltz from https://flat.io/score/5ae0d2898345a64c7afc4570-amelies-waltz
int constexpr amelieTempo1 = TEMPO(96);
int constexpr amelieTempo2 = TEMPO(180);

Note constexpr PROGMEM amelie1_14[] = {
	// Part 1
	{D5, NL_2(amelieTempo1)}, {D5, NL_8dot(amelieTempo1)}, {C5, NL_16(amelieTempo1)}, 
	{B4, NL_2dot(amelieTempo1)}, {A4, NL_4(amelieTempo1)}, 
	{D5, NL_2(amelieTempo1)}, {D5, NL_8(amelieTempo1)}, {E5, NL_8(amelieTempo1)}, {D5, NL_16(amelieTempo1)}, {C5, NL_16(amelieTempo1)}, {B4, NL_16(amelieTempo1)}, {C5, NL_16(amelieTempo1)}, 
	{B4, NL_2dot(amelieTempo1)}, {A4, NL_4(amelieTempo1)}, 
	{C5, NL_2dot(amelieTempo1)}, {C5, NL_8dot(amelieTempo1)}, {B4, NL_16(amelieTempo1)}, 
	{E4, NLx1(amelieTempo1)}, 

	// Part 7
	{C5, NL_2(amelieTempo1)}, {C5, NL_8(amelieTempo1)}, {D5, NL_8(amelieTempo1)}, {C5, NL_16(amelieTempo1)}, {B4, NL_16(amelieTempo1)}, {C5, NL_16(amelieTempo1)}, {B4, NL_16(amelieTempo1)}, 
	{E4, NLx1(amelieTempo1)}, 
	// Part 9
	{D5, NL_2dot(amelieTempo1)}, {D5, NL_8(amelieTempo1)}, {C5, NL_8(amelieTempo1)}, 
	{B4, NL_2dot(amelieTempo1)}, {A4, NL_2(amelieTempo1)},
	// Part 11
	{D5, NL_2(amelieTempo1)}, {D5, NL_8(amelieTempo1)}, {C5, NL_8(amelieTempo1)}, {D5, NL_16(amelieTempo1)}, {C5, NL_16(amelieTempo1)}, {B4, NL_16(amelieTempo1)}, {C5, NL_16(amelieTempo1)}, 
	{B4, NL_2dot(amelieTempo1)}, {A4, NL_4(amelieTempo1)}, 
	{C5, NL_2dot(amelieTempo1)}, {C5, NL_8(amelieTempo1)}, {B4, NL_8(amelieTempo1)}, 
	// Part 14
	{A4, NLx1(amelieTempo1)}, 
	{C5, NL_2(amelieTempo1)}, {C5, NL_8(amelieTempo1)}, {D5, NL_8(amelieTempo1)}, {C5, NL_16(amelieTempo1)}, {B4, NL_16(amelieTempo1)}, {C5, NL_16(amelieTempo1)}, {B4, NL_16(amelieTempo1)}, 
	{A4, NLx1(amelieTempo1)}
};
// Tempo to 180
Note constexpr PROGMEM amelie17_19n21_23[] = {
	// Part 17-19, 21-23
	{D5, NL_8(amelieTempo2)}, {E4, NL_8(amelieTempo2)}, {F4, NL_8(amelieTempo2)}, {E4, NL_8(amelieTempo2)}, {F4, NL_8(amelieTempo2)}, {E4, NL_8(amelieTempo2)}, 
	{D5, NL_8(amelieTempo2)}, {E4, NL_8(amelieTempo2)}, {F4, NL_8(amelieTempo2)}, {C5, NL_8(amelieTempo2)}, {E4, NL_8(amelieTempo2)}, {F4, NL_8(amelieTempo2)}, 
	{B4, NL_8(amelieTempo2)}, {D4, NL_8(amelieTempo2)}, {E4, NL_8(amelieTempo2)}, {D4, NL_8(amelieTempo2)}, {E4, NL_8(amelieTempo2)}, {D4, NL_8(amelieTempo2)}
};
Note constexpr PROGMEM amelie20[] = {
	// Part 20
	{A4, NL_8(amelieTempo2)}, {D4, NL_8(amelieTempo2)}, {E4, NL_8(amelieTempo2)}, {D4, NL_8(amelieTempo2)}, {E4, NL_8(amelieTempo2)}, {D4, NL_8(amelieTempo2)}
};
Note constexpr PROGMEM amelie24n36n40[] = {
	// Parts 24, 36, 40.. ad nauseaum
	{A4, NL_8(amelieTempo2)}, {C4, NL_8(amelieTempo2)}, {D4, NL_8(amelieTempo2)}, {E4, NL_8(amelieTempo2)}, {D4, NL_8(amelieTempo2)}, {C4, NL_8(amelieTempo2)}
};
Note constexpr PROGMEM amelie25n26n29_30n39n41n45[] = {
	{C5, NL_8(amelieTempo2)}, {E4, NL_8(amelieTempo2)}, {F4, NL_8(amelieTempo2)}, {E4, NL_8(amelieTempo2)}, {F4, NL_8(amelieTempo2)}, {E4, NL_8(amelieTempo2)}
};
Note constexpr PROGMEM amelie27n31n35n39[] = {
	{B4, NL_8(amelieTempo2)}, {D4, NL_8(amelieTempo2)}, {E4, NL_8(amelieTempo2)}, {D4, NL_8(amelieTempo2)}, {E4, NL_8(amelieTempo2)}, {D4, NL_8(amelieTempo2)}
};
Note constexpr PROGMEM amelie28n32n44n48[] = {
	{E4, NL_8(amelieTempo2)}, {D4, NL_8(amelieTempo2)}, {C4, NL_8(amelieTempo2)}, {E4, NL_8(amelieTempo2)}, {D4, NL_8(amelieTempo2)}, {C4, NL_8(amelieTempo2)}
};
Note constexpr PROGMEM amelie33[] = {
	{D5, NL_8(amelieTempo2)}, {E4, NL_8(amelieTempo2)}, {F4, NL_8(amelieTempo2)}, {E4, NL_8(amelieTempo2)}, {F4, NL_8(amelieTempo2)}, {E4, NL_8(amelieTempo2)}
};
Note constexpr PROGMEM amelie34n38[] = {
	{E5, NL_8(amelieTempo2)}, {E4, NL_8(amelieTempo2)}, {F4, NL_8(amelieTempo2)}, {C5, NL_8(amelieTempo2)}, {E4, NL_8(amelieTempo2)}, {F4, NL_8(amelieTempo2)}
};
Note constexpr PROGMEM amelie42[] = {
	{C5, NL_8(amelieTempo2)}, {E4, NL_8(amelieTempo2)}, {F4, NL_8(amelieTempo2)}, {C5, NL_8(amelieTempo2)}, {E4, NL_8(amelieTempo2)}, {F4, NL_8(amelieTempo2)}
};
Note constexpr PROGMEM amelie43n47[] = {
	{G4, NL_8(amelieTempo2)}, {D4, NL_8(amelieTempo2)}, {E4, NL_8(amelieTempo2)}, {D4, NL_8(amelieTempo2)}, {E4, NL_8(amelieTempo2)}, {D4, NL_8(amelieTempo2)}
};
Note constexpr PROGMEM amelie46[] = {
	{C5, NL_8(amelieTempo2)}, {E4, NL_8(amelieTempo2)}, {F4, NL_8(amelieTempo2)}, {B4, NL_8(amelieTempo2)}, {E4, NL_8(amelieTempo2)}, {F4, NL_8(amelieTempo2)}
};
Note constexpr PROGMEM amelie49[] = {
	{D5, NL_2dot(amelieTempo2)}
};

SongPart constexpr amelieSong[] = {
	// Maybe not play the intro
	// {amelie1_14, sizeof(amelie1_14)/sizeof(amelie1_14[0])},
	{amelie17_19n21_23, sizeof(amelie17_19n21_23)/sizeof(amelie17_19n21_23[0])},
	{amelie20, sizeof(amelie20)/sizeof(amelie20[0])},
	{amelie17_19n21_23, sizeof(amelie17_19n21_23)/sizeof(amelie17_19n21_23[0])},
	{amelie24n36n40, sizeof(amelie24n36n40)/sizeof(amelie24n36n40[0])},
	{amelie25n26n29_30n39n41n45, sizeof(amelie25n26n29_30n39n41n45)/sizeof(amelie25n26n29_30n39n41n45[0])},
	{amelie27n31n35n39, sizeof(amelie27n31n35n39)/sizeof(amelie27n31n35n39[0])},
	{amelie28n32n44n48, sizeof(amelie28n32n44n48)/sizeof(amelie28n32n44n48[0])},
	{amelie25n26n29_30n39n41n45, sizeof(amelie25n26n29_30n39n41n45)/sizeof(amelie25n26n29_30n39n41n45[0])},
	{amelie25n26n29_30n39n41n45, sizeof(amelie25n26n29_30n39n41n45)/sizeof(amelie25n26n29_30n39n41n45[0])},
	{amelie27n31n35n39, sizeof(amelie27n31n35n39)/sizeof(amelie27n31n35n39[0])},
	{amelie28n32n44n48, sizeof(amelie28n32n44n48)/sizeof(amelie28n32n44n48[0])},
	{amelie33, sizeof(amelie33)/sizeof(amelie33[0])},
	{amelie34n38, sizeof(amelie34n38)/sizeof(amelie34n38[0])},
	{amelie27n31n35n39, sizeof(amelie27n31n35n39)/sizeof(amelie27n31n35n39[0])},
	{amelie24n36n40, sizeof(amelie24n36n40)/sizeof(amelie24n36n40[0])},
	{amelie25n26n29_30n39n41n45, sizeof(amelie25n26n29_30n39n41n45)/sizeof(amelie25n26n29_30n39n41n45[0])},
	{amelie34n38, sizeof(amelie34n38)/sizeof(amelie34n38[0])},
	{amelie25n26n29_30n39n41n45, sizeof(amelie25n26n29_30n39n41n45)/sizeof(amelie25n26n29_30n39n41n45[0])},
	{amelie24n36n40, sizeof(amelie24n36n40)/sizeof(amelie24n36n40[0])},
	{amelie25n26n29_30n39n41n45, sizeof(amelie25n26n29_30n39n41n45)/sizeof(amelie25n26n29_30n39n41n45[0])},
	{amelie42, sizeof(amelie42)/sizeof(amelie42[0])},
	{amelie43n47, sizeof(amelie43n47)/sizeof(amelie43n47[0])},
	{amelie28n32n44n48, sizeof(amelie28n32n44n48)/sizeof(amelie28n32n44n48[0])},
	{amelie25n26n29_30n39n41n45, sizeof(amelie25n26n29_30n39n41n45)/sizeof(amelie25n26n29_30n39n41n45[0])},
	{amelie46, sizeof(amelie46)/sizeof(amelie46[0])},
	{amelie43n47, sizeof(amelie43n47)/sizeof(amelie43n47[0])},
	{amelie28n32n44n48, sizeof(amelie28n32n44n48)/sizeof(amelie28n32n44n48[0])},
	{amelie49, sizeof(amelie49)/sizeof(amelie49[0])}
};


Song constexpr allSongs[] = {
	{"Imperial March", 0xF800, vaderSong, sizeof(vaderSong)/sizeof(vaderSong[0])},
	{"Game of Thrones", 0xFA40, gotSong, sizeof(gotSong)/sizeof(gotSong[0])},
	{"Amelie's Waltz", 0xFFE0, amelieSong, sizeof(amelieSong)/sizeof(amelieSong[0])}
};


// ****************************************************************************
// *** Stuff for music                                                      ***
// ****************************************************************************

void playNotes(Note const *const notes, int const size)
{
	for (Note const *note=notes; note<notes+size; ++note) {
		int const freq = pgm_read_word(&note->f);
		int const time = pgm_read_word(&note->t);
		tone(BUZZER_PIN, freq, time);
		delay(time + 10);
	}
}


void playSong(SongPart const *songParts, int parts)
{
	while (parts) {
		playNotes(songParts->notes, songParts->size);
		--parts;
		++songParts;
	}
}


void playNextNote(SongPart const *const songParts, int const parts, SongPart const **const pSongPart, Note const **const pNote, SoftTimer *const timer)
{
	int const freq = pgm_read_word(&((*pNote)->f));
	int const time = pgm_read_word(&((*pNote)->t));
	tone(BUZZER_PIN, freq, time);

	SongPart const *part = *pSongPart;
	if (++(*pNote) >= part->notes + part->size) {
		if (++(*pSongPart) >= songParts + parts) {
			return;
		}
		part = *pSongPart;
		*pNote = part->notes;
	}

	timer->init(time + 10, SoftTimer::ONESHOT);
}


// ****************************************************************************
// *** Stuff for display                                                    ***
// ****************************************************************************

static Adafruit_SSD1331 display = Adafruit_SSD1331(CS_PIN, DC_PIN, RST_PIN);
static uint8_t const width = display.width();
static uint8_t const height = display.height();
static uint8_t const radius = (int) width * 5 / 8;


// SSD1331 takes in 16-bit RBG pixels (5 red, 6 green, 5 blue).
//
//  ----------------------------------------------------------------------------
// | Color    | RED                 | GREEN               | BLUE                |
// |----------|-----------------------------------------------------------------|
// | Bits     | 5                   | 6                   | 5                   |
// | Values   | [0..31]             | [0..63]             | [0..31]             |
// | Shift    | << 11               | << 5                | << 0                |
// | Bin mask | 0b11111000 00000000 | 0b00000111 11100000 | 0b00000000 00011111 |
// | Hex mask | 0xF8000             | 0x07E0              | 0x001F              |
//  ----------------------------------------------------------------------------

// uint8_t toRed(uint16_t const color) { return (color >> 11) & 0x1f; }
constexpr uint8_t toRed(uint16_t const color) { return (color >> 11) & 0x1f; }
constexpr uint8_t toGreen(uint16_t const color) { return (color >> 5) & 0x3f; }
constexpr uint8_t toBlue(uint16_t const color) { return color & 0x1f; }
constexpr uint16_t toColor(uint16_t const r, uint16_t const g, uint16_t const b) { return ((r & 0x1f) << 11) | ((g & 0x3f) << 5) | (b & 0x1f); }

#define	BLACK      0x0000
#define	BLUE       0x001F
#define	RED        0xF800
#define	GREEN      0x07E0
#define CYAN       0x07FF
#define MAGENTA    0xF81F
#define YELLOW     0xFFE0
#define ORANGE     0xFA40
#define WHITE      0xFFFF


//
// Routines to draw monochrome, 2-bit, 4-bit and 16-bit picture data on screen
//
void draw1bitData(uint8_t const *data, uint16_t const color, int const w, int const h)
{
	int const loops = w * h / 8;

	for(int i=loops; i; --i) {
		uint8_t byte = pgm_read_byte(data);
		for (int bit=8; bit; --bit) {
			display.writeColor((byte & 1) ? color : BLACK, 1);
			byte >>= 1;
		}
		++data;
	}
}


void draw2bitData(uint8_t const *data, uint16_t const *palette, int const w, int const h)
{
	for (int row=h; row; --row) {
		for (int col=w; col>0; col-=4) {
			uint8_t byte = pgm_read_byte(data);
			switch(col) {
			default:
				display.writeColor(palette[byte & 0x3], 1);
				byte >>= 2;
			case 3:
				display.writeColor(palette[byte & 0x3], 1);
				byte >>= 2;
			case 2:
				display.writeColor(palette[byte & 0x3], 1);
				byte >>= 2;
			case 1:
				display.writeColor(palette[byte & 0x3], 1);
				break;
			}
			++data;
		}
	}
}


void draw4bitData(uint8_t const *data, uint16_t const *palette, int const w, int const h)
{
	for (int row=h; row; --row) {
		for (int col=w; col>0; col-=2) {
			uint8_t const byte = pgm_read_byte(data);
			display.writeColor(palette[byte & 0xF], 1);
			if (col > 1) {
				display.writeColor(palette[byte >> 4], 1);
			}
			++data;
		}
	}
}


void draw16bitData(uint16_t const *data, int const w, int const h)
{
	int const loops = w * h;

	for (int i=0; i<loops; ++i) {
		display.writeColor(pgm_read_word(data), 1);
		data++;
	}
}


// ****************************************************************************
// *** Images created with bmp2arduino (in the same repo)                   ***
// ****************************************************************************

#include <stdint.h>
#include <avr/pgmspace.h>

// 1-bit picture data extracted from file ../tea-timer/motd.bmp
uint16_t constexpr motdColor = toColor(0, 0x3f / 3, 0x1f);
int constexpr motdWidth = 96;
int constexpr motdHeight = 217;
static uint8_t const PROGMEM motdData[] = {
    0x00, 0x00, 0x80, 0x73, 0x00, 0x00, 0x00, 0x00, 0x00, 0x0e, 0x1c, 0x00, 
    0x78, 0x3c, 0x00, 0x63, 0x00, 0x00, 0x00, 0x00, 0x00, 0x0c, 0x18, 0x03, 
    0x30, 0x18, 0x00, 0x63, 0x00, 0x00, 0x00, 0x00, 0x00, 0x0c, 0x18, 0x03, 
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    0x00, 0x00, 0x00, 0x00, 0x00, 0x00, 0x00, 0x00, 0x00, 0xf8, 0x00, 0x00, 
};


// 4-bit picture data extracted from file arrow.bmp
int constexpr arrowPicWidth = 24;
int constexpr arrowPicHeight = 34;
static uint8_t const PROGMEM arrowPicData[] = {
    0x00, 0x00, 0x00, 0x00, 0x00, 0x10, 0x02, 0x00, 0x00, 0x00, 0x00, 0x00, 
    0x00, 0x00, 0x00, 0x00, 0x00, 0x21, 0x21, 0x00, 0x00, 0x00, 0x00, 0x00, 
    0x00, 0x00, 0x00, 0x00, 0x10, 0x32, 0x13, 0x02, 0x00, 0x00, 0x00, 0x00, 
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    0x00, 0x00, 0x11, 0x11, 0x11, 0x11, 0x11, 0x11, 0x11, 0x21, 0x00, 0x00, 
};

static uint16_t const arrowPicPalette[16] = {0x0000, 0xffff, 0xd6ba, 0x233d, 0x001f, 0x543e, 0x74ff, 0xffff, 0xffff, 0xffff, 0xffff, 0xffff, 0xffff, 0xffff, 0xffff, 0xffff};


// 2-bit picture data extracted from file teacup.bmp
int constexpr teacupPicWidth = 46;
int constexpr teacupPicHeight = 27;
static uint8_t const PROGMEM teacupPicData[] = {
    0x00, 0x00, 0x00, 0x55, 0x55, 0x55, 0x55, 0x55, 0x01, 0x00, 0x00, 0x00, 
    0x00, 0x00, 0x55, 0xaa, 0xaa, 0xaa, 0xaa, 0xaa, 0x56, 0x01, 0x00, 0x00, 
    0x00, 0x40, 0xaa, 0xaa, 0xaa, 0xaa, 0xaa, 0xaa, 0xaa, 0x06, 0x00, 0x00, 
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    0x00, 0x00, 0x40, 0x55, 0x55, 0x55, 0x55, 0x55, 0x05, 0x00, 0x00, 0x00, 
};

static uint16_t const teacupPicPalette[4] = {0x0000, 0xffff, 0xaaa0, 0x8430};


// 2-bit picture data extracted from file steam.bmp
int constexpr steamPicWidth = 19;
int constexpr steamPicHeight = 12;
static uint8_t const PROGMEM steamPicData[] = {
    0x90, 0x00, 0x25, 0x40, 0x02, 
    0x24, 0x40, 0x02, 0x90, 0x00, 
    0x08, 0x90, 0x00, 0x24, 0x00, 
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    0x40, 0x02, 0x90, 0x00, 0x09, 
};

static uint16_t const steamPicPalette[4] = {0x0000, 0xffff, 0x8430, 0xffff};


// ****************************************************************************
// *** Higher level code                                                    ***
// ****************************************************************************

static SoftTimer clockTimer(1000, SoftTimer::STOPPED);
static BtnDebounce upBtn(BTNUP_PIN, LOW, 20);
static BtnDebounce dnBtn(BTNDN_PIN, LOW, 20);


bool checkButtons(bool const mayChangeTime = false)
{
	if (upBtn.isPressed()) {
		if (mayChangeTime) {
			if (clockTimer.shotsLeft() == 0) {
				clockTimer.reinit(2 * 60 + 30);
			}
			else if (clockTimer.shotsLeft() > 9 * 60 + 45) {
				clockTimer.reinit(9 * 60 + 59);
			}
			else {
				clockTimer.reinit(clockTimer.shotsLeft() + 15);
			}
		}
		randomSeed(micros());
		return true;
	}
	if (dnBtn.isPressed()) {
		if (mayChangeTime) {
			clockTimer.reinit(clockTimer.shotsLeft() > 15 ? clockTimer.shotsLeft() - 15 : 0);
		}
		randomSeed(micros());
		return true;
	}
	return false;
}


bool wait4Button(int const ms)
{
	SoftTimer deadline(ms);
	while (!deadline.hasExpired()) {
		if (checkButtons()) {
			return true;
		}
	}
	return false;	
}


bool fadingText(char const *const text, int const x, int const y, uint16_t const firstColor, uint16_t const lastColor, int steps)
{
	bool out = false;
	float const deltaRed = (float) (toRed(firstColor) - toRed(lastColor)) / steps;
	float const deltaGreen = (float) (toGreen(firstColor) - toGreen(lastColor)) / steps;
	float const deltaBlue = (float) (toBlue(firstColor) - toBlue(lastColor)) / steps;

	for (--steps; steps >= 0; --steps) {
		float const factor = steps;
		uint16_t const color = toColor(toRed(lastColor) + deltaRed * factor, toGreen(lastColor) + deltaGreen * factor, toBlue(lastColor) + deltaBlue * factor);
		display.setCursor(x, y);
		display.setTextColor(color);
		display.print(text);
		if (checkButtons()) {
			out = true;
		}
	}

	return out;
}


bool animateMotd(void)
{
	bool out = false;
	int constexpr stepsToFade = 30;
	float constexpr deltaRed = (float) toRed(motdColor) / stepsToFade;
	float constexpr deltaGreen = (float) toGreen(motdColor) / stepsToFade;
	float constexpr deltaBlue = (float) toBlue(motdColor) / stepsToFade;

	int steps = stepsToFade;
	int offset = -height;

	display.fillScreen(BLACK);

	while (steps > 0  &&  offset < motdHeight + 1) {
		if (out) {
			--steps;
		}
		float const factor = steps;
		uint16_t const color = toColor(deltaRed * factor, deltaGreen * factor, deltaBlue * factor);

		out |= checkButtons();

		display.setAddrWindow(0, 0, width, height);
		display.startWrite();

		if (offset < 0) {
			display.writeColor(BLACK, -offset * motdWidth);
			draw1bitData(motdData, color, motdWidth, height + offset);
		}
		else if (offset < motdHeight - height) {
			draw1bitData(motdData + offset * motdWidth / 8, color, motdWidth, height);
		}
		else {
			draw1bitData(motdData + offset * motdWidth / 8, color, motdWidth, motdHeight - offset);
			display.writeColor(BLACK, (height - (motdHeight - offset)) * motdWidth);
		}

		display.endWrite();

		++offset;
	}

	return out;
}


bool showSongs(void)
{
	bool out = false;

	display.fillScreen(BLACK);
	display.setTextSize(2);

	out = fadingText("Jukebox", 5, 0, BLACK, motdColor, 100);
	if (!out)  out = wait4Button(1000);

	for (unsigned int i=0; !out && i<sizeof(allSongs)/sizeof(allSongs[0]); ++i) {
		if (!out) out = fadingText(allSongs[i].name, 0, 30, BLACK, allSongs[i].nameColor, 60);
		if (!out) out = wait4Button(1000);
		out |= fadingText(allSongs[i].name, 0, 30, allSongs[i].nameColor, BLACK, 60);
		if (!out) out = wait4Button(1000);
	}

	if (!out) out = wait4Button(500);
	out |= fadingText("Jukebox", 5, 0, motdColor, BLACK, 100);
	display.fillScreen(BLACK);
	return out;
}


// Draw time on screen. Last 5 secods are one digit only and with circle animation
void drawTime(int time)
{
	uint16_t constexpr firstColor = GREEN;
	uint16_t constexpr lastColor = RED;
	static float constexpr deltaRed = (float) (toRed(firstColor) - toRed(lastColor)) / 60.0f;
	static float constexpr deltaGreen = (float) (toGreen(firstColor) - toGreen(lastColor)) / 60.0f;
	static float constexpr deltaBlue = (float) (toBlue(firstColor) - toBlue(lastColor)) / 60.0f;

	// Determine sliding color from firstColor to lastColor using remaining time as a factor
	float const factor = time > 60 ? 60 : time;
	uint16_t const color = toColor(toRed(lastColor) + deltaRed * factor, toGreen(lastColor) + deltaGreen * factor, toBlue(lastColor) + deltaBlue * factor);

	// Circle animation
	// if (time < 6) {
	// 	for (uint8_t i=0; i<radius; i+=5) {
	// 		display.fillCircle(width / 2, height / 2, i, color);
	// 	}
	// }

	display.setTextColor(color);

	// Minutes and seconds
	if (time > 5) {
		display.fillScreen(BLACK);

		int const minutes = time / 60;
		time %= 60;
		int const secondTens = time / 10;
		time %= 10;
		int const secondUnits = time;

		display.setTextSize(4);
		display.setCursor(0, 20);
		display.print(minutes);
		display.print(':');
		display.print(secondTens);
		display.print(secondUnits);
	}
	// One digit only
	else if (time > 0) {
		for (uint8_t i=0; i<radius; i+=5) {
			display.fillCircle(width / 2, height / 2, i, color);
		}
		display.fillScreen(BLACK);

		display.setTextSize(4);
		display.setCursor(40, 20);
		display.print(time);
	}
}


void animateSteam(int offset, int x, int y)
{
	int constexpr rowBytes = (steamPicWidth + 3) / 4;

	display.setAddrWindow(x, y, steamPicWidth, steamPicHeight);
	display.startWrite();
	draw2bitData(steamPicData + offset * rowBytes, steamPicPalette, steamPicWidth, steamPicHeight - offset);
	draw2bitData(steamPicData, steamPicPalette, steamPicWidth, offset);
	display.endWrite();
}


void teacupAnimation(void)
{
	display.fillScreen(BLACK);

	// Draw teacup
	display.setAddrWindow(26, 25, teacupPicWidth, teacupPicHeight);
	display.startWrite();
	draw2bitData(teacupPicData, teacupPicPalette, teacupPicWidth, teacupPicHeight);
	display.endWrite();

	// Animate steam
	int heightOffset = 0;
	int cont = 1200;
	SoftTimer delayTimer;

	while (cont) {
		animateSteam(heightOffset, 39, 13);
		if (++heightOffset >= steamPicHeight) {
			heightOffset = 0;
		}
		--cont;
		delayTimer.init(100, SoftTimer::ONESHOT);
		while (!delayTimer.hasExpired()) {
			if (checkButtons()) {
				cont = 0;
				break;
			}
		}
	}

	display.fillScreen(BLACK);
}


void teacupAnimationWithSong(SongPart const *const songParts, int const parts)
{
	display.fillScreen(BLACK);

	// Draw teacup
	display.setAddrWindow(26, 25, teacupPicWidth, teacupPicHeight);
	display.startWrite();
	draw2bitData(teacupPicData, teacupPicPalette, teacupPicWidth, teacupPicHeight);
	display.endWrite();

	// Animate steam
	int constexpr rowBytes = (steamPicWidth + 3) / 4;
	int heightOffset = 0;
	int cont = 1200;
	SoftTimer animationDelay;

	SoftTimer musicDelay(0, SoftTimer::ONESHOT);  // Immediately
	SongPart const *songPart = songParts;
	Note const *note = songPart->notes;

	while (cont) {
		display.setAddrWindow(39, 13, steamPicWidth, steamPicHeight);
		display.startWrite();

		// This animates the steam
		int row = heightOffset;
		do {
			if (musicDelay.hasExpired()) {
				playNextNote(songParts, parts, &songPart, &note, &musicDelay);
			}
			draw2bitData(steamPicData + row * rowBytes, steamPicPalette, steamPicWidth, 1);
			if (++row >= steamPicHeight) {
				row = 0;
			}
		} while (row != heightOffset);

		display.endWrite();

		if (++heightOffset >= steamPicHeight) {
			heightOffset = 0;
		}
		--cont;
		animationDelay.init(100, SoftTimer::ONESHOT);

		// This plays music between steam animation
		while (!animationDelay.hasExpired()) {
			if (musicDelay.hasExpired()) {
				playNextNote(songParts, parts, &songPart, &note, &musicDelay);
			}
			if (checkButtons()) {
				if (musicDelay.shotsLeft()  &&  !clockTimer.shotsLeft()) {
					musicDelay.stop();
					noTone(BUZZER_PIN);
				}
				else {
					cont = 0;
				}
				break;
			}
		}
	}

	display.fillScreen(BLACK);
}


void setup() {
	Serial.begin(115200);
	display.begin();
	display.fillScreen(BLACK);

	Serial.println("Hello World! Tea timer (c) Sami Sorell.");
	Serial.print("Display SSD1331 16-bit color OLED, resolution ");
	Serial.print(width);
	Serial.print("x");
	Serial.print(height);
	Serial.println(".");

	pinMode(BTNUP_PIN, INPUT_PULLUP);
	pinMode(BTNDN_PIN, INPUT_PULLUP);

	pinMode(BUZZER_PIN, OUTPUT);

	if (!animateMotd()) {
		showSongs();
	}
	randomSeed(micros());
}


void loop() {
	// When shotsLeft() == 0 no number is drawn, but the red circle effect is
	drawTime(clockTimer.shotsLeft());

	while (!clockTimer.hasExpired()) {
		if (checkButtons(true)) {
			break;
		}
	}

	if (clockTimer.shotsLeft() == 0) {
		// Tea is served!
		clockTimer.reinit(0);
		int const songNum = random(sizeof(allSongs)/sizeof(allSongs[0]));
		teacupAnimationWithSong(allSongs[songNum].parts, allSongs[songNum].size);
	}
}
